AUTOSAR XML (schema 00048)
package /#{AR_PACKAGE}/#{COMPONENT}_PortInterfaces
  client server interface IFCS_#{COMPONENT}
    operation #{COMPONENT}_global_service: diag-arg-integrity=false, fire-and-forget=false, possible-error=E_NOT_OK
      arg cmd_id: type=uint8, direction=IN
      arg size_in_b: type=uint8, direction=INOUT
      arg data: type=uint64_Array, direction=INOUT
    error E_NOT_OK: error-code=1
